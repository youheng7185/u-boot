## arch/arm/mach-snapdragon/Kconfig
```kconfig
if ARCH_SNAPDRAGON

config TARGET_J2Y18LTE
	bool "Samsung Galaxy J2 2018 (MSM8917)"
	select OF_CONTROL
	select OF_EMBED
	select DM_SERIAL
	select DM_MMC
	select MMC
	select MMC_SDHCI
	select MMC_SDHCI_MSM
	select SERIAL
	select J2_FB_SERIAL
	select LINUX_KERNEL_IMAGE_HEADER
	help
	  Minimal chainloaded U-Boot for Samsung Galaxy J2 2018. The Android
	  bootloader's DTB is ignored; U-Boot uses a tiny built-in control FDT
	  and writes its console directly to the framebuffer left active by S-Boot.

config SYS_SOC
	default "snapdragon"

config SYS_VENDOR
	string "Snapdragon board vendor"
	default "qualcomm"
	help
	  Allows to specify vendor for the Snapdragon SoCs based boards.
	  Based on this option board/<CONFIG_SYS_VENDOR>/<CONFIG_SYS_BOARD>
	  will be used as the custom board directory.

config SYS_MALLOC_F_LEN
	default 0x2000

config SPL_SYS_MALLOC_F
	default y

config SPL_SYS_MALLOC_F_LEN
	default 0x2000

config SYS_MALLOC_LEN
	default 0x800000

config LNX_KRNL_IMG_TEXT_OFFSET_BASE
	default 0x80000000

config SPL_SHARES_INIT_SP_ADDR
	# override the default from common/spl/Kconfig
	default n

config SPL_HAVE_INIT_STACK
	default y

config SYS_BOARD
	string "Snapdragon SoCs based board"
	help
	  Allows to specify the Snapdragon SoCs based board name.
	  Based on this option board/<CONFIG_SYS_VENDOR>/<CONFIG_SYS_BOARD>
	  will be used as the custom board directory.

config SYS_CONFIG_NAME
	string "Board configuration name"
	default SYS_BOARD if SYS_BOARD != ""
	default "qcom"
	help
	  This option contains information about board configuration name.
	  Based on this option include/configs/<CONFIG_SYS_CONFIG_NAME>.h header
	  will be used for board configuration.

config QCOM_GENERATE_MBN
	bool "Generate an MBN-compatible ELF binary"
	help
	  Enable this if you intend to flash U-Boot as a first-stage bootloader.
	  The build system will generate a board-specific ELF file with the appropriate
	  MBN hash segments and test keys.

	  New platforms can be added to tools/qcom/mkmbn/mkmbn.py if they aren't already
	  supported.

choice
	prompt "Qualcomm boot0.h workaround"
	optional
	help
	  While U-Boot on Qualcomm platforms doesn't generally need compile-time
	  adjustments based on the target SoC, workarounds in boot0.h can't
	  practically detect the SoC at runtime. Enable one of these workarounds
	  if you know you need it.

config BOOT0_MSM8916_PSCI_WORKAROUND
	bool "boot0.h workaround for buggy PSCI on the msm8916 SoC"
	help
	  Select this if you are building U-Boot proper for an msm8916 board that
	  uses the buggy PSCI implementation.

config BOOT0_SDM845_WORKAROUND
	bool "boot0.h workaround for SPL on the sdm845 SoC"
	depends on SPL
	help
	  Select this if you are building U-Boot SPL for sdm845.

endchoice

endif
```

## board/samsung/exynos-mobile/Kconfig
```kconfig
if TARGET_EXYNOS_MOBILE

config GTS9FEPWIFI
	bool "Samsung Galaxy Tab S9 FE+ Wi-Fi (SM-X610)"
	help
	  Use the stock S-Boot devicetree and its display handover buffer.

config ENV_SOURCE_FILE
	default "exynos-mobile"

config LNX_KRNL_IMG_TEXT_OFFSET_BASE
	default TEXT_BASE

config SYS_BOARD
	default "exynos-mobile"

config SYS_CONFIG_NAME
	default "exynos-mobile"

config SYS_VENDOR
	default "samsung"

endif # TARGET_EXYNOS_MOBILE
```

## configs/gts9fepwifi_defconfig
```kconfig
CONFIG_ARM=y
CONFIG_SKIP_LOWLEVEL_INIT=y
CONFIG_POSITION_INDEPENDENT=y
CONFIG_SYS_INIT_SP_BSS_OFFSET=0x400000
CONFIG_ARCH_EXYNOS=y
CONFIG_TARGET_EXYNOS_MOBILE=y
CONFIG_GTS9FEPWIFI=y
CONFIG_COUNTER_FREQUENCY=26000000
CONFIG_ARMV8_CNTFRQ_BROKEN=y
CONFIG_SYS_MALLOC_LEN=0x1000000
CONFIG_SYS_MALLOC_DEFAULT_TO_INIT=y
CONFIG_SYS_MALLOC_F_LEN=0x200000
CONFIG_SYS_LOAD_ADDR=0x80000000
CONFIG_NR_DRAM_BANKS=3
CONFIG_DEFAULT_DEVICE_TREE="s5e8835-gts9fepwifi"
CONFIG_OF_BOARD=y
# CONFIG_OF_UPSTREAM is not set
CONFIG_SAVE_PREV_BL_FDT_ADDR=y
CONFIG_ENV_SOURCE_FILE="gts9fepwifi"
CONFIG_ENV_IS_NOWHERE=y
CONFIG_SYS_DEVICE_NULLDEV=y
CONFIG_GTS9_FB_SERIAL=y
# CONFIG_REQUIRE_SERIAL_CONSOLE is not set
CONFIG_BOOTDELAY=0
# CONFIG_DISPLAY_CPUINFO is not set
# CONFIG_PSCI_RESET is not set
# CONFIG_EFI_LOADER is not set
# CONFIG_VIDEO is not set
```

## configs/msm8917_j2y18lte_defconfig
```kconfig
CONFIG_ARM=y
CONFIG_ARCH_SNAPDRAGON=y
CONFIG_TARGET_J2Y18LTE=y
CONFIG_SKIP_LOWLEVEL_INIT=y
CONFIG_BOARD_EARLY_INIT_F=y
CONFIG_SYS_VENDOR="qualcomm"
CONFIG_SYS_BOARD="msm8917_j2"
CONFIG_SYS_CONFIG_NAME="msm8917_j2"
CONFIG_TEXT_BASE=0x90000000
CONFIG_SYS_LOAD_ADDR=0x90000000
CONFIG_LNX_KRNL_IMG_TEXT_OFFSET_BASE=0x80000000
CONFIG_HAS_CUSTOM_SYS_INIT_SP_ADDR=y
CONFIG_CUSTOM_SYS_INIT_SP_ADDR=0x91000000
CONFIG_DEFAULT_DEVICE_TREE="msm8917-j2y18lte"
# CONFIG_OF_UPSTREAM is not set
CONFIG_SYS_MALLOC_F_LEN=0x2000
CONFIG_SYS_MALLOC_LEN=0x800000
CONFIG_ENV_RELOC_GD_ENV_ADDR=y
CONFIG_CMD_MMC=y
CONFIG_CMD_EXT4=y
CONFIG_CMD_FAT=y
CONFIG_CMD_FS_GENERIC=y
CONFIG_EFI_PARTITION=y
CONFIG_FS_EXFAT=y
CONFIG_HUSH_PARSER=y
CONFIG_PINCTRL=y
CONFIG_PINCTRL_GENERIC=y
CONFIG_PINCTRL_QCOM_APQ8016=y
CONFIG_MSM_GPIO=y
CONFIG_CLK=y
CONFIG_DM_RESET=y
CONFIG_POWER_DOMAIN=y
CONFIG_CLK_QCOM_APQ8016=y
CONFIG_NR_DRAM_BANKS=24
CONFIG_OF_CONTROL=y
CONFIG_OF_EMBED=y
CONFIG_DM=y
CONFIG_DM_SERIAL=y
CONFIG_SERIAL=y
CONFIG_SERIAL_PRESENT=y
CONFIG_REQUIRE_SERIAL_CONSOLE=y
CONFIG_J2_FB_SERIAL=y
CONFIG_LINUX_KERNEL_IMAGE_HEADER=y
CONFIG_SYS_PROMPT="j2y18lte => "
CONFIG_BOOTDELAY=2
CONFIG_SUPPORT_RAW_INITRD=y
CONFIG_USE_BOOTCOMMAND=y
CONFIG_BOOTCOMMAND="mmc dev 0; setenv bootargs root=/dev/mmcblk0p2 rootwait rootfstype=ext4 rw init=/init console=tty0 clk_ignore_unused pd_ignore_unused ignore_loglevel earlyprintk deferred_probe_timeout=600; if load mmc 0:1 ${kernel_addr_r} Image; then echo Linux Image loaded; if load mmc 0:1 ${fdt_addr_r} msm8917-samsung-j2y18lte.dtb; then echo DTB loaded; booti ${kernel_addr_r} - ${fdt_addr_r}; fi; fi; echo SD boot files not found"
# CONFIG_DISPLAY_CPUINFO is not set
# CONFIG_DISPLAY_BOARDINFO is not set
```
